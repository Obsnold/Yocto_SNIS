## conf/layer.conf
```bitbake
BBPATH .= ":${LAYERDIR}"

BBFILES += "${LAYERDIR}/recipes-*/*/*.bb \
            &{LAYERDIR}/recipes-*/*/*.bbappend"

BBFILE_COLLECTIONS += "meta-snis"
BBFILE_PATTERN_meta-snis = "^${LAYERDIR}/"
BBFILE_PRIORITY_meta-snis = "6"

LAYERSERIES_COMPAT_meta-snis = "dunfell"
```
